## boards/shields/CosmosKBv1/Kconfig.shield
```kconfig
config SHIELD_COSMOS_V1_LEFT
    def_bool $(shields_list_contains,cosmos_v1_left)

config SHIELD_COSMOS_V1_RIGHT
    def_bool $(shields_list_contains,cosmos_v1_right)
```
